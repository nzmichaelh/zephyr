/*
 * Copyright (c) 2025 Michael Hope <michaelh@juju.nz>
 *
 * SPDX-License-Identifier: Apache-2.0
 */

/ {
	leds {
		status = "disabled";
	};
};

&pwmleds {
	status = "okay";
};

&tim4 {
	status = "okay";
	/*
	 * The sample blinks the LED at 0.5 Hz, ceil(120 MHz / 65536 / 0.5 Hz)
	 * is 3663, and the prescaler property is one less than that.
	*/
	prescaler = <3662>;
	pinctrl-0 = <&blue_pwm_pinctrl>;
	pinctrl-names = "default";
};
