## prj.conf
```kconfig
CONFIG_USB=y
CONFIG_USB_DEVICE_STACK=y
CONFIG_USB_DEVICE_HID=y

CONFIG_SYS_LOG=y
CONFIG_SYS_LOG_USB_DRIVER_LEVEL=1
CONFIG_SYS_LOG_USB_DEVICE_LEVEL=1

CONFIG_USB_DEVICE_VID=0x10c4
CONFIG_USB_DEVICE_PID=0x8acf
CONFIG_NET_BUF=y

CONFIG_TINYCRYPT=y
CONFIG_TINYCRYPT_SHA256=y
CONFIG_TINYCRYPT_SHA256_HMAC=y
CONFIG_TINYCRYPT_SHA256_HMAC_PRNG=y
CONFIG_TINYCRYPT_ECC_DH=y
CONFIG_TINYCRYPT_ECC_DSA=y

CONFIG_CONSOLE_SHELL=y
CONFIG_SYSTEM_WORKQUEUE_STACK_SIZE=3000
CONFIG_INIT_STACKS=y
#CONFIG_STACK_CANARIES=y
CONFIG_KERNEL_SHELL=y

CONFIG_FLASH=y
CONFIG_SOC_FLASH_SAM0=y
CONFIG_FLASH_MAP=y
CONFIG_FCB=y
CONFIG_FLASH_PAGE_LAYOUT=y
CONFIG_FLASH_MAP_CUSTOM=y
```

## src/main.c
```c
/*
 * Copyright (c) 2016 Intel Corporation.
 *
 * SPDX-License-Identifier: Apache-2.0
 */

#define SYS_LOG_LEVEL 4
#define SYS_LOG_DOMAIN "main"
#include <logging/sys_log.h>

#include <zephyr.h>

void main(void)
{
	SYS_LOG_DBG("Starting application");

	for (;;) {
		k_sleep(K_SECONDS(2));
	}
}
```

## src/hid.c
```c
/*
 * Copyright (c) 2016 Intel Corporation.
 *
 * SPDX-License-Identifier: Apache-2.0
 */

#define SYS_LOG_LEVEL 4
#define SYS_LOG_DOMAIN "hid"
#include <logging/sys_log.h>

#include <misc/byteorder.h>
#include <net/buf.h>
#include <string.h>
#include <zephyr.h>
#include <device.h>
#include <init.h>

#include <usb/class/usb_hid.h>
#include <usb/usb_device.h>

#define TYPE_MASK 0x80
#define TYPE_INIT 0x80
#define TYPE_CONT 0x00

#define U2FHID_PING (TYPE_INIT | 0x01)
#define U2FHID_MSG (TYPE_INIT | 0x03)
#define U2FHID_LOCK (TYPE_INIT | 0x04)
#define U2FHID_INIT (TYPE_INIT | 0x06)
#define U2FHID_WINK (TYPE_INIT | 0x08)
#define U2FHID_ERROR (TYPE_INIT | 0x3f)

#define CAPABILITY_WINK 0x01
#define CAPABILITY_LOCK 0x02

#define U2FHID_BROADCAST 0xffffffff

#define U2FHID_PACKET_SIZE 64
#define U2FHID_INIT_PAYLOAD_SIZE (U2FHID_PACKET_SIZE - 7)
#define U2FHID_CONT_PAYLOAD_SIZE (U2FHID_PACKET_SIZE - 5)
#define U2FHID_MAX_PAYLOAD_SIZE (7609)

void dump_hex(const char *msg, const u8_t *buf, int len);
int u2f_dispatch(struct net_buf *req, struct net_buf *resp);

struct u2f_init_hdr {
	u32_t cid;
	u8_t cmd;
	u8_t bcnt[2];
	u8_t payload[1];
};
BUILD_ASSERT(sizeof(struct u2f_init_hdr) == 8);

struct u2f_init_pkt {
	u32_t cid;
	u8_t cmd;
	u8_t bcnt[2];
	u8_t payload[U2FHID_INIT_PAYLOAD_SIZE];
};
BUILD_ASSERT(sizeof(struct u2f_init_pkt) == U2FHID_PACKET_SIZE);

struct u2f_cont_pkt {
	u32_t cid;
	u8_t seq;
	u8_t payload[U2FHID_CONT_PAYLOAD_SIZE];
};
BUILD_ASSERT(sizeof(struct u2f_cont_pkt) == U2FHID_PACKET_SIZE);

struct hid_data {
	u32_t next_channel;
	u32_t cid;

	struct net_buf *rx;
	u32_t rx_cid;
	u8_t rx_cmd;
	u16_t rx_want;
	u8_t rx_seq;
	struct k_work rx_work;
	struct k_fifo rx_q;

	struct k_fifo tx_q;
	struct k_work tx_work;

	struct net_buf *tx;
	int tx_seq;
};

static struct hid_data data;

NET_BUF_POOL_DEFINE(hid_msg_pool, 4, 700, 0, NULL);

/* Some HID sample Report Descriptor */
static const u8_t hid_report_desc[] = {
	0x06, 0xd0,
	0xf1,       /* USAGE_PAGE (FIDO Alliance) */
	0x09, 0x01, /* USAGE (Keyboard) */
	0xa1, 0x01, /* COLLECTION (Application) */

	0x09, 0x20, /* USAGE (Input Report Data) */
	0x15, 0x00, /* LOGICAL_MINIMUM (0) */
	0x26, 0xff,
	0x00,			  /* LOGICAL_MAXIMUM (255) */
	0x75, 0x08,		  /* REPORT_SIZE (8) */
	0x95, U2FHID_PACKET_SIZE, /* REPORT_COUNT (64) */
	0x81, 0x02,		  /* INPUT (Data,Var,Abs) */
	0x09, 0x21,		  /* USAGE(Output Report Data) */
	0x15, 0x00,		  /* LOGICAL_MINIMUM (0) */
	0x26, 0xff,
	0x00,			  /* LOGICAL_MAXIMUM (255) */
	0x75, 0x08,		  /* REPORT_SIZE (8) */
	0x95, U2FHID_PACKET_SIZE, /* REPORT_COUNT (64) */
	0x91, 0x02,		  /* OUTPUT (Data,Var,Abs) */

	0xc0, /* END_COLLECTION */
};

static void hid_tx(struct k_work *work)
{
	int err;
	u32_t wrote;
	int at;
	int stride;

	if (data.tx == NULL) {
		data.tx = net_buf_get(&data.tx_q, K_NO_WAIT);
		data.tx_seq = -1;
	}
	if (data.tx == NULL) {
		SYS_LOG_DBG("done");
		return;
	}

	if (data.tx_seq < 0) {
		at = 0;
		stride = U2FHID_PACKET_SIZE;
		err = usb_write(CONFIG_HID_INT_EP_ADDR, data.tx->data,
				U2FHID_PACKET_SIZE, &wrote);
	} else {
		struct u2f_cont_pkt pkt = {
			.cid = *(u32_t *)(data.tx->data), .seq = data.tx_seq,
		};

		at = U2FHID_PACKET_SIZE +
		     (data.tx_seq * U2FHID_CONT_PAYLOAD_SIZE);
		stride = U2FHID_CONT_PAYLOAD_SIZE;
		memcpy(pkt.payload, data.tx->data + at, stride);
		err = usb_write(CONFIG_HID_INT_EP_ADDR, (u8_t *)&pkt,
				sizeof(pkt), &wrote);
	}

	if (err == 0) {
		prng_feed();

		data.tx_seq++;
		if (at + stride >= data.tx->len) {
			net_buf_unref(data.tx);
			data.tx = NULL;
		}
	}

	k_work_submit(&data.tx_work);
}

static int hid_handle_init(struct net_buf *req, struct net_buf *resp)
{
	SYS_LOG_DBG("");

	net_buf_add_mem(resp, req->data, 8);
	net_buf_pull(req, 8);
	net_buf_add_be32(resp, ++data.next_channel);
	net_buf_add_u8(resp, 2);
	net_buf_add_u8(resp, 0);
	net_buf_add_u8(resp, 1);
	net_buf_add_u8(resp, 0);
	net_buf_add_u8(resp, CAPABILITY_WINK);

	return 0;
}

static void hid_rx(struct k_work *work)
{
	struct net_buf *req;
	struct net_buf *resp = NULL;
	struct u2f_init_hdr *hdr;
	u8_t *bcnt;
	int err = 0;

	SYS_LOG_DBG("");

	req = k_fifo_get(&data.rx_q, K_NO_WAIT);
	if (req == NULL) {
		goto done;
	}

	dump_hex("<<", req->data, req->len);

	hdr = (struct u2f_init_hdr *)req->data;
	net_buf_pull(req, offsetof(struct u2f_init_hdr, payload));

	SYS_LOG_DBG("cid=%x cmd=%x", hdr->cid, hdr->cmd);

	resp = net_buf_alloc(&hid_msg_pool, K_NO_WAIT);
	if (resp == NULL) {
		err = -ENOMEM;
		goto done;
	}

	net_buf_add_mem(resp, &hdr->cid, sizeof(hdr->cid));
	net_buf_add_u8(resp, hdr->cmd);
	bcnt = net_buf_add(resp, 2);

	switch (hdr->cmd) {
	case U2FHID_INIT:
		err = hid_handle_init(req, resp);
		break;
	case U2FHID_MSG:
		err = u2f_dispatch(req, resp);
		break;
	default:
		err = -EINVAL;
	}

	if (err != 0) {
		goto done;
	}

	sys_put_be16(resp->len - 4 - 1 - 2, bcnt);

	dump_hex(">>", resp->data, resp->len);
	net_buf_ref(resp);
	net_buf_put(&data.tx_q, resp);
	k_work_submit(&data.tx_work);

done:
	if (resp != NULL) {
		net_buf_unref(resp);
	}
	if (req != NULL) {
		net_buf_unref(req);
	}
	if (!k_fifo_is_empty(&data.rx_q)) {
		k_work_submit(work);
	}
}

static int hid_set_report_cb(struct usb_setup_packet *setup, s32_t *plen,
			     u8_t **pdata)
{
	struct u2f_init_pkt *pkt = (struct u2f_init_pkt *)*pdata;
	int len = *plen;

	prng_feed();

	if (len < offsetof(struct u2f_cont_pkt, payload)) {
		return -EINVAL;
	}
	if ((pkt->cmd & TYPE_INIT) != 0) {
		u16_t bcnt;

		if (len < offsetof(struct u2f_init_pkt, payload)) {
			SYS_LOG_ERR("init packet too short");
			return -EINVAL;
		}
		bcnt = sys_get_be16(pkt->bcnt);
		if (bcnt > U2FHID_MAX_PAYLOAD_SIZE) {
			SYS_LOG_ERR("bcnt too big");
			return -EINVAL;
		}

		SYS_LOG_DBG("cmd=%x bcnt=%d", pkt->cmd, bcnt);
		if (data.rx != NULL) {
			net_buf_unref(data.rx);
			data.rx = NULL;
		}

		data.rx = net_buf_alloc(&hid_msg_pool, K_NO_WAIT);
		if (data.rx == NULL) {
			SYS_LOG_ERR("No memory");
			return -ENOMEM;
		}

		data.rx_cid = pkt->cid;
		data.rx_want = bcnt + offsetof(struct u2f_init_pkt, payload);
		data.rx_seq = 0;

		net_buf_add_mem(data.rx, (u8_t *)pkt, len);
	} else {
		struct u2f_cont_pkt *cont = (struct u2f_cont_pkt *)*pdata;

		if (data.rx == NULL) {
			SYS_LOG_ERR("no rx buf");
			return -EINVAL;
		}
		if (cont->cid != data.rx_cid) {
			SYS_LOG_ERR("cid changed");
			return -EINVAL;
		}
		if (cont->seq != data.rx_seq) {
			SYS_LOG_ERR("seq out of order");
			return -EINVAL;
		}
		data.rx_seq = cont->seq + 1;
		SYS_LOG_DBG("seq=%x", cont->seq);

		net_buf_add_mem(data.rx, cont->payload, len - 5);
	}

	if (data.rx != NULL && data.rx->len >= data.rx_want) {
		SYS_LOG_DBG("dispatch");
		net_buf_put(&data.rx_q, data.rx);
		data.rx = NULL;
		k_work_submit(&data.rx_work);
	}

	return 0;
}

static int hid_get_report_cb(struct usb_setup_packet *setup, s32_t *len,
			     u8_t **data)
{
	SYS_LOG_DBG("Get report callback");
	return 0;
}

static const struct hid_ops ops = {
	.get_report = hid_get_report_cb,
	.set_report = hid_set_report_cb,
};

static int hid_init(struct device *dev)
{
	k_fifo_init(&data.rx_q);
	k_fifo_init(&data.tx_q);
	k_work_init(&data.tx_work, hid_tx);
	k_work_init(&data.rx_work, hid_rx);

	usb_hid_register_device(hid_report_desc, sizeof(hid_report_desc),
				&ops);
	return usb_hid_init();
}

SYS_INIT(hid_init, APPLICATION, CONFIG_APPLICATION_INIT_PRIORITY);
```

## src/prng_sam0.c
```c
/*
 * Copyright (c) 2016 Intel Corporation.
 *
 * SPDX-License-Identifier: Apache-2.0
 */

#define SYS_LOG_LEVEL 4
#define SYS_LOG_DOMAIN "prng"
#include <logging/sys_log.h>

#include <misc/byteorder.h>
#include <net/buf.h>
#include <string.h>
#include <zephyr.h>
#include <device.h>
#include <init.h>

#include <tinycrypt/constants.h>
#include <tinycrypt/hmac_prng.h>

#include <arch/arm/cortex_m/cmsis.h>

#define SERIAL_0 0x0080A00C
#define SERIAL_1 0x0080A040
#define SERIAL_2 0x0080A044
#define SERIAL_3 0x0080A048

struct prng_data {
	struct tc_hmac_prng_struct prng;
	u32_t entropy[17];
	u8_t at;
};

static struct prng_data data;

static void prng_add(u32_t ch)
{
	data.entropy[data.at++] = ch;
	if (data.at >= ARRAY_SIZE(data.entropy)) {
		data.at = 0;
	}
}

void prng_feed(void)
{
	prng_add(SysTick->VAL);
	prng_add(k_uptime_get_32());
}

int default_CSPRNG(u8_t *buf, unsigned int len)
{
	int err;

	for (;;) {
		err = tc_hmac_prng_generate(buf, len, &data.prng);

		switch (err) {
		case TC_CRYPTO_SUCCESS:
			return err;
		case TC_HMAC_PRNG_RESEED_REQ:
			prng_feed();
			dump_hex("entropy", data.entropy,
				 sizeof(data.entropy));
			err = tc_hmac_prng_reseed(
				&data.prng, (u8_t *)data.entropy,
				sizeof(data.entropy), NULL, 0);
			if (err != TC_CRYPTO_SUCCESS) {
				return err;
			}
			break;
		default:
			return TC_CRYPTO_FAIL;
		}
	}
}

static int prng_init(struct device *dev)
{
	u32_t personalization[] = {
		*(u32_t *)SERIAL_0, *(u32_t *)SERIAL_1, *(u32_t *)SERIAL_2,
		*(u32_t *)SERIAL_3, (u32_t)prng_init,
	};
	int err;

	err = tc_hmac_prng_init(&data.prng, (u8_t *)personalization,
				sizeof(personalization));
	if (err != TC_CRYPTO_SUCCESS) {
		return -EIO;
	}
	return 0;
}

SYS_INIT(prng_init, APPLICATION, CONFIG_APPLICATION_INIT_PRIORITY);
```

## src/sfs.h
```c
/*
 * Copyright (c) 2018 Google LLC.
 *
 * SPDX-License-Identifier: Apache-2.0
 */

#ifndef _FS_SFS_H_
#define _FS_SFS_H_

#include <sys/types.h>
#include <fs.h>

#ifdef __cplusplus
extern "C" {
#endif

#define MAX_FILE_NAME 12

typedef s16_t sfs_block;

struct sfs_file {
	sfs_block block;
	s16_t offset;
	s16_t size;
	u8_t name[MAX_FILE_NAME+1];
};

struct sfs_dir {
	s16_t block;
};

struct sfs_dirent {
	enum fs_dir_entry_type type;
	char name[MAX_FILE_NAME + 1];
	size_t size;
};

int sfs_open(struct sfs_file *zfp, const char *file_name);
int sfs_close(struct sfs_file *zfp);
int sfs_unlink(const char *path);
ssize_t sfs_read(struct sfs_file *zfp, void *ptr, size_t size);
ssize_t sfs_write(struct sfs_file *zfp, const void *ptr, size_t size);
int sfs_opendir(struct sfs_dir *zdp, const char *path);
int sfs_readdir(struct sfs_dir *zdp, struct sfs_dirent *entry);
int sfs_stat(const char *path, struct sfs_dirent *entry);

#ifdef __cplusplus
}
#endif

#endif
```

## src/u2f.c
```c
/*
 * Copyright (c) 2016 Intel Corporation.
 *
 * SPDX-License-Identifier: Apache-2.0
 */

#define SYS_LOG_LEVEL 4
#define SYS_LOG_DOMAIN "u2f"
#include <logging/sys_log.h>

#include <misc/byteorder.h>
#include <net/buf.h>
#include <string.h>
#include <zephyr.h>

#include <mbedtls/base64.h>
#include <tinycrypt/constants.h>
#include <tinycrypt/ecc_dh.h>
#include <tinycrypt/ecc_dsa.h>
#include <tinycrypt/ecc_platform_specific.h>
#include <tinycrypt/sha256.h>

#include "sfs.h"

#define U2F_EC_FMT_UNCOMPRESSED 0x04

#define U2F_EC_POINT_SIZE 32
#define U2F_EC_PUBKEY_SIZE 65
#define U2F_APDU_SIZE 7
#define U2F_CHALLENGE_SIZE 32
#define U2F_APPLICATION_SIZE 32
#define U2F_KEY_HANDLE_ID_SIZE 8
#define U2F_KEY_HANDLE_KEY_SIZE 36
#define U2F_KEY_HANDLE_SIZE (U2F_KEY_HANDLE_KEY_SIZE + U2F_KEY_HANDLE_ID_SIZE)
#define U2F_REGISTER_REQUEST_SIZE (U2F_CHALLENGE_SIZE + U2F_APPLICATION_SIZE)
#define U2F_MAX_REQUEST_PAYLOAD                                              \
	(1 + U2F_CHALLENGE_SIZE + U2F_APPLICATION_SIZE + 1 +                 \
	 U2F_KEY_HANDLE_SIZE)

/* U2F native commands */
#define U2F_REGISTER 0x01
#define U2F_AUTHENTICATE 0x02
#define U2F_VERSION 0x03
#define U2F_VENDOR_FIRST 0xc0
#define U2F_VENDOR_LAST 0xff

#define U2F_ERASE 0xc1
#define U2F_SET_CERTIFICATE 0xc2
#define U2F_SET_PRIVATE_KEY 0xc3

/* U2F_CMD_REGISTER command defines */
#define U2F_REGISTER_ID 0x05
#define U2F_REGISTER_HASH_ID 0x00

/* U2F Authenticate */
#define U2F_AUTHENTICATE_CHECK 0x7
#define U2F_AUTHENTICATE_SIGN 0x3

/* Command status responses */
#define U2F_SW_NO_ERROR 0x9000
#define U2F_SW_WRONG_DATA 0x6984
#define U2F_SW_CONDITIONS_NOT_SATISFIED 0x6985
#define U2F_SW_INS_NOT_SUPPORTED 0x6d00
#define U2F_SW_WRONG_LENGTH 0x6700
#define U2F_SW_CLASS_NOT_SUPPORTED 0x6E00
#define U2F_SW_WRONG_PAYLOAD 0x6a80
#define U2F_SW_INSUFFICIENT_MEMORY 0x9210

#define U2F_PRIVATE_KEY_NAME "/attest.pk"
#define U2F_CERTIFICATE_NAME "/attest.der"

struct slice {
	const u8_t *p;
	int len;
};

static u16_t u2f_map_err(int err)
{
	switch (err) {
	case 0:
		return U2F_SW_NO_ERROR;
	case -EINVAL:
		return U2F_SW_WRONG_DATA;
	case -EPERM:
		return U2F_SW_CONDITIONS_NOT_SATISFIED;
	case -ENOENT:
		return U2F_SW_INS_NOT_SUPPORTED;
	case -ENOMEM:
		return U2F_SW_INSUFFICIENT_MEMORY;
	default:
		SYS_LOG_DBG("err=%d", err);
		return U2F_SW_WRONG_DATA;
	}
}

const u8_t *get_p(struct slice *s, int offset, int len)
{
	if (offset < 0 || len < 0) {
		return NULL;
	}
	if (offset + len > s->len) {
		return NULL;
	}
	return s->p + offset;
}

int get_u8(struct slice *s, int offset)
{
	const u8_t *p = get_p(s, offset, 1);

	if (p == NULL) {
		return -EINVAL;
	}
	return *p;
}

void dump_hex(const char *msg, const u8_t *buf, int len)
{
	printk("%s(%d): ", msg, len);
	for (int i = 0; i < len; i++) {
		printk(" %x", buf[i]);
	}
	printk("\n");
}

static int net_buf_add_varint(struct net_buf *resp, const u8_t *buf, int len)
{
	net_buf_add_u8(resp, 0x02);

	if ((buf[0] & 0x80) != 0) {
		net_buf_add_le16(resp, len + 1);
		net_buf_add_mem(resp, buf, len);

		return len + 1 + 2;
	}

	net_buf_add_u8(resp, len);
	net_buf_add_mem(resp, buf, len);

	return len + 1 + 1;
}

static void net_buf_add_x962(struct net_buf *resp, const u8_t *signature)
{
	/* Encode the signature in X9.62 format */
	net_buf_add_u8(resp, 0x30);
	u8_t *len = net_buf_add(resp, 1);

	*len = 0;

	*len += net_buf_add_varint(resp, &signature[0], 32);
	*len += net_buf_add_varint(resp, &signature[32], 32);
}

static int u2f_write_file(const char *fname, struct slice *pc)
{
	struct sfs_file fp;
	int err;

	err = sfs_open(&fp, fname);
	if (err != 0) {
		SYS_LOG_ERR("sfs_open err=%d", err);
		return err;
	}

	err = sfs_write(&fp, pc->p, pc->len);
	if (err != pc->len) {
		SYS_LOG_ERR("sfs_write err=%d", err);
		return err;
	}

	err = sfs_close(&fp);
	if (err != 0) {
		SYS_LOG_ERR("sfs_close err=%d", err);
		return err;
	}

	return 0;
}

static int u2f_read_file(const char *fname, u8_t *buf, int len)
{
	struct sfs_dirent entry;
	struct sfs_file fp;
	int err;

	err = sfs_stat(fname, &entry);
	if (err != 0) {
		SYS_LOG_ERR("sfs_stat");
		return err;
	}

	err = sfs_open(&fp, fname);
	if (err != 0) {
		SYS_LOG_ERR("sfs_open");
		return err;
	}

	err = sfs_read(&fp, buf, len);
	sfs_close(&fp);

	return err;
}

static int u2f_write_private(const u8_t *private, u8_t *handle)
{
	struct slice s = {
		.p = private, .len = 32,
	};

	for (;;) {
		u8_t key[6];
		struct sfs_dirent entry;
		int err;
		size_t olen;

		handle[0] = '/';

		/* Create a handle */
		if (default_CSPRNG(key, sizeof(key)) != TC_CRYPTO_SUCCESS) {
			SYS_LOG_ERR("default_CSPRNG");
			return -EIO;
		}

		/* Make the handle printable */
		err = mbedtls_base64_encode(handle + 1, 8 + 1, &olen, key,
					    sizeof(key));
		if (err != 0) {
			SYS_LOG_ERR("base64_encode err=%d", err);
			return -ENOMEM;
		}

		strcat(handle, ".pk");

		if (sfs_stat(handle, &entry) == 0) {
			/* Handle already exists, try again. */
			continue;
		}

		err = u2f_write_file(handle, &s);
		if (err != 0) {
			SYS_LOG_ERR("err=%d", err);
			return err;
		}

		return 0;
	}
	while (true)
		;
}

static int u2f_authenticate(int p1, struct slice *pc, int le,
			    struct net_buf *resp)
{
	const u8_t *chal = get_p(pc, 0, 32);
	const u8_t *app = get_p(pc, 32, 32);
	int l = get_u8(pc, 64);
	const u8_t *handle = get_p(pc, 65, l);
	u8_t fname[MAX_FILE_NAME + 1];
	int err;

	SYS_LOG_DBG("chal=%p app=%p l=%d handle=%p", chal, app, l, handle);

	if (chal == NULL || app == NULL || l < 0 || handle == NULL) {
		return -EINVAL;
	}

	dump_hex("chal", chal, 32);
	dump_hex("app", app, 32);
	dump_hex("handle", handle, l);

	if (l != MAX_FILE_NAME) {
		return -EINVAL;
	}
	memcpy(fname, handle, l);
	fname[sizeof(fname) - 1] = '\0';

	/* Fetch the private key */
	u8_t private[32];

	err = u2f_read_file(fname, private, sizeof(private));
	if (err != sizeof(private)) {
		return -EINVAL;
	}

	dump_hex("private", private, sizeof(private));

	/* Add user presence */
	net_buf_add_u8(resp, 1);

	/* Add the press counter */
	net_buf_add_be32(resp, 0x01010101);

	/* Generate the digest */
	struct tc_sha256_state_struct sha;

	if (tc_sha256_init(&sha) != TC_CRYPTO_SUCCESS) {
		SYS_LOG_ERR("tc_sha256_init");
		return -ENOMEM;
	}

	tc_sha256_update(&sha, app, 32);

	u8_t ch = 1;

	tc_sha256_update(&sha, &ch, sizeof(ch));

	u32_t w = 0x01010101;

	tc_sha256_update(&sha, &w, sizeof(w));
	tc_sha256_update(&sha, chal, 32);

	u8_t digest[TC_SHA256_DIGEST_SIZE];

	tc_sha256_final(digest, &sha);

	/* Generate the signature */
	u8_t signature[64];

	if (uECC_sign(private, digest, sizeof(digest), signature,
		      uECC_secp256r1()) != TC_CRYPTO_SUCCESS) {
		SYS_LOG_ERR("uECC_sign");
		return -ENOMEM;
	}

	net_buf_add_x962(resp, signature);

	return 0;
}

static int u2f_register(int p1, struct slice *pc, int le,
			struct net_buf *resp)
{
	const u8_t *chal = get_p(pc, 0, 32);
	const u8_t *app = get_p(pc, 32, 32);
	u8_t private[32];
	u8_t ch;
	int err;

	if (pc->len != 64) {
		SYS_LOG_ERR("lc=%d", pc->len);
		return -EINVAL;
	}

	/* Add the header */
	net_buf_add_u8(resp, 0x05);

	/* Reserve space for the public key */
	net_buf_add_u8(resp, U2F_EC_FMT_UNCOMPRESSED);
	u8_t *public = net_buf_add(resp, 64);

	/* Generate a new public/private key pair */
	if (uECC_make_key(public, private, uECC_secp256r1()) !=
	    TC_CRYPTO_SUCCESS) {
		SYS_LOG_ERR("uECC_make_key");
		return -ENOMEM;
	}

	u8_t handle[MAX_FILE_NAME + 1];

	err = u2f_write_private(private, handle);
	if (err != 0) {
		SYS_LOG_ERR("write_private");
		return err;
	}

	net_buf_add_u8(resp, sizeof(handle) - 1);
	net_buf_add_mem(resp, handle, sizeof(handle) - 1);

	/* Add the attestation certificate */
	err = u2f_read_file(U2F_CERTIFICATE_NAME, net_buf_tail(resp),
			    net_buf_tailroom(resp));
	if (err < 0) {
		return err;
	}
	if (err == 0) {
		return -EINVAL;
	}
	net_buf_add(resp, err);

	/* Generate the digest */
	struct tc_sha256_state_struct sha;

	if (tc_sha256_init(&sha) != TC_CRYPTO_SUCCESS) {
		SYS_LOG_ERR("tc_sha256_init");
		return -ENOMEM;
	}

	ch = 0;
	tc_sha256_update(&sha, &ch, sizeof(ch));
	tc_sha256_update(&sha, app, 32);
	tc_sha256_update(&sha, chal, 32);
	tc_sha256_update(&sha, handle, sizeof(handle) - 1);
	ch = U2F_EC_FMT_UNCOMPRESSED;
	tc_sha256_update(&sha, &ch, sizeof(ch));
	tc_sha256_update(&sha, public, 64);

	u8_t digest[TC_SHA256_DIGEST_SIZE];

	tc_sha256_final(digest, &sha);

	/* Generate the signature */
	u8_t signature[64];
	u8_t key[32];

	err = u2f_read_file(U2F_PRIVATE_KEY_NAME, key, sizeof(key));
	if (err < 0) {
		return err;
	}
	if (err != sizeof(key)) {
		return -EINVAL;
	}
	if (uECC_sign(key, digest, sizeof(digest), signature,
		      uECC_secp256r1()) != TC_CRYPTO_SUCCESS) {
		SYS_LOG_ERR("uECC_sign");
		return -ENOMEM;
	}

	net_buf_add_x962(resp, signature);

	return 0;
}

static int u2f_version(int p1, struct slice *pc, int le, struct net_buf *resp)
{
	net_buf_add_mem(resp, "U2F_V2", 6);

	return 0;
}

static int u2f_write_once(const char *fname, struct slice *pc)
{
	struct sfs_dirent entry;

	if (sfs_stat(fname, &entry) == 0) {
		SYS_LOG_ERR("%s exists", fname);
		return -EEXIST;
	}

	return u2f_write_file(fname, pc);
}

static int u2f_set_private_key(struct slice *pc)
{
	if (pc->len != 32) {
		return -EINVAL;
	}

	return u2f_write_once(U2F_PRIVATE_KEY_NAME, pc);
}

static int u2f_set_certificate(struct slice *pc)
{
	return u2f_write_once(U2F_CERTIFICATE_NAME, pc);
}

static int u2f_erase(void)
{
	struct sfs_dir dir;
	int err;

	err = sfs_opendir(&dir, "/");
	if (err != 0) {
		return err;
	}

	for (;;) {
		struct sfs_dirent ent;

		err = sfs_readdir(&dir, &ent);
		SYS_LOG_DBG("err=%d name=%s", err, ent.name);

		if (err != 0) {
			goto err;
		}

		if (ent.name[0] == '\0') {
			return sfs_closedir(&dir);
		}

		err = sfs_unlink(ent.name);
		if (err != 0) {
			goto err;
		}
	}

err:
	sfs_closedir(&dir);
	return err;
}

int u2f_dispatch(struct net_buf *req, struct net_buf *resp)
{
	u8_t cla;
	u8_t ins;
	u8_t p1;
	u8_t p2;
	struct slice pc;
	u16_t le = 0;
	int err;

	SYS_LOG_DBG("");

	dump_hex("<<", req->data, req->len);

	cla = net_buf_pull_u8(req);
	if (cla != 0) {
		SYS_LOG_ERR("bad cla");
		return -EINVAL;
	}

	ins = net_buf_pull_u8(req);
	p1 = net_buf_pull_u8(req);
	p2 = net_buf_pull_u8(req);

	if (net_buf_pull_u8(req) != 0) {
		SYS_LOG_ERR("Bad lc header");
		return -EINVAL;
	}

	pc.len = net_buf_pull_be16(req);
	pc.p = req->data;
	req->data += pc.len;
	req->len -= pc.len;

	if (req->len > 0) {
		le = net_buf_pull_be16(req);
	}

	SYS_LOG_DBG("ins=%d p1=%d p2=%d lc=%d le=%d", ins, p1, p2, pc.len,
		    le);
	switch (ins) {
	case U2F_REGISTER:
		err = u2f_register(p1, &pc, le, resp);
		break;
	case U2F_AUTHENTICATE:
		err = u2f_authenticate(p1, &pc, le, resp);
		break;
	case U2F_VERSION:
		err = u2f_version(p1, &pc, le, resp);
		break;
	case U2F_SET_PRIVATE_KEY:
		err = u2f_set_private_key(&pc);
		break;
	case U2F_SET_CERTIFICATE:
		err = u2f_set_certificate(&pc);
		break;
	case U2F_ERASE:
		err = u2f_erase();
		break;
	default:
		SYS_LOG_ERR("ins=%d not supported", ins);
		err = -ENOENT;
		break;
	}

	SYS_LOG_DBG("err=%d", err);
	net_buf_add_be16(resp, u2f_map_err(err));

	return 0;
}
```

## src/u2f.h
```c
/*
 * Copyright (c) 2016, Conor Patrick
 * All rights reserved.
 *
 * Redistribution and use in source and binary forms, with or without
 * modification, are permitted provided that the following conditions are met:
 *
 * 1. Redistributions of source code must retain the above copyright notice,
 this
 *    list of conditions and the following disclaimer.
 * 2. Redistributions in binary form must reproduce the above copyright
 notice,
 *    this list of conditions and the following disclaimer in the
 documentation
 *    and/or other materials provided with the distribution.
 *
 * THIS SOFTWARE IS PROVIDED BY THE COPYRIGHT HOLDERS AND CONTRIBUTORS "AS IS"
 AND
 * ANY EXPRESS OR IMPLIED WARRANTIES, INCLUDING, BUT NOT LIMITED TO, THE
 IMPLIED
 * WARRANTIES OF MERCHANTABILITY AND FITNESS FOR A PARTICULAR PURPOSE ARE
 * DISCLAIMED. IN NO EVENT SHALL THE COPYRIGHT OWNER OR CONTRIBUTORS BE LIABLE
 FOR
 * ANY DIRECT, INDIRECT, INCIDENTAL, SPECIAL, EXEMPLARY, OR CONSEQUENTIAL
 DAMAGES
 * (INCLUDING, BUT NOT LIMITED TO, PROCUREMENT OF SUBSTITUTE GOODS OR
 SERVICES;
 * LOSS OF USE, DATA, OR PROFITS; OR BUSINESS INTERRUPTION) HOWEVER CAUSED AND
 * ON ANY THEORY OF LIABILITY, WHETHER IN CONTRACT, STRICT LIABILITY, OR TORT
 * (INCLUDING NEGLIGENCE OR OTHERWISE) ARISING IN ANY WAY OUT OF THE USE OF
 THIS
 * SOFTWARE, EVEN IF ADVISED OF THE POSSIBILITY OF SUCH DAMAGE.
 */

#ifndef _U2F_H_
#define _U2F_H_

#include <stdint.h>


#endif /* U2F_H_ */
```
