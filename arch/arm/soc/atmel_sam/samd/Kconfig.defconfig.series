## arch/arm/soc/atmel_sam/samd/Kconfig.defconfig.series
```kconfig
# Kconfig - Atmel SAMD MCU series configuration options
*
# SPDX-License-Identifier: Apache-2.0
#

if SOC_SERIES_SAMD

config SOC_SERIES
	string
	default samd

config SOC_PART_NUMBER
	string
	default samd21g18a if SOC_PART_NUMBER_SAMD21G18A

config NUM_IRQS
	int
	default 29

config SYS_CLOCK_HW_CYCLES_PER_SEC
	int
	default 48000000

endif # SOC_SERIES_SAMD
```

## arch/arm/soc/atmel_sam/samd/Kconfig.series
```kconfig
# Kconfig - Atmel SAMD MCU series
#

config SOC_SERIES_SAMD
	bool "Atmel SAMD MCU"
	select CPU_CORTEX_M
	select CPU_CORTEX_M0PLUS
	select SOC_FAMILY_SAM
	select SYS_POWER_LOW_POWER_STATE_SUPPORTED
	select CPU_HAS_SYSTICK
	select ASF
	help
	  Enable support for Atmel SAMD Cortex-M0+ microcontrollers.
```

## arch/arm/soc/atmel_sam/samd/Kconfig.soc
```kconfig
# Kconfig - Atmel SAM3X MCU series
#
# SPDX-License-Identifier: Apache-2.0
#

choice
	prompt "Atmel SAMD MCU Selection"
	depends on SOC_SERIES_SAMD

	config SOC_PART_NUMBER_SAMD21G18A
		bool "SAMD21G18A"
endchoice
```

## boards/arm/adafruit_itsybitsy_m4_express/adafruit_itsybitsy_m4_express_defconfig
```kconfig
# SPDX-License-Identifier: Apache-2.0

CONFIG_SOC_SERIES_SAMD51=y
CONFIG_SOC_PART_NUMBER_SAMD51G19A=y
CONFIG_BOARD_ADAFRUIT_ITSYBITSY_M4_EXPRESS=y
CONFIG_SOC_ATMEL_SAMD5X_OSCULP32K_AS_MAIN=y
CONFIG_CORTEX_M_SYSTICK=y
CONFIG_CONSOLE=y
CONFIG_UART_CONSOLE=y
CONFIG_SERIAL=y
CONFIG_UART_SAM0=y
CONFIG_GPIO=y
CONFIG_GPIO_SAM0=y
CONFIG_USE_DT_CODE_PARTITION=y
CONFIG_PINMUX=y
CONFIG_PINMUX_SAM0=y
CONFIG_ENTROPY_SAM_RNG=y
CONFIG_WDT_SAM0=y
CONFIG_SPI=y
CONFIG_SPI_SAM0_QSPI=y
CONFIG_FLASH=y
CONFIG_SHELL=y
CONFIG_FLASH_SHELL=y
CONFIG_BUILD_OUTPUT_HEX=y
CONFIG_DEBUG_OPTIMIZATIONS=y
CONFIG_SPI_NOR=y
CONFIG_DEBUG=y
```

## boards/arm/arduino_zero/Kconfig.board
```kconfig
# Kconfig - Arduino Zero Board configuration
#
# SPDX-License-Identifier: Apache-2.0
#

config BOARD_ARDUINO_ZERO
	bool "Arduino Zero"
	depends on SOC_PART_NUMBER_SAMD21G18A
```

## boards/arm/arduino_zero/arduino_zero_defconfig
```kconfig
# SPDX-License-Identifier: Apache-2.0

CONFIG_SOC_SERIES_SAMD21=y
CONFIG_SOC_PART_NUMBER_SAMD21G18A=y
CONFIG_BOARD_ARDUINO_ZERO=y
CONFIG_CORTEX_M_SYSTICK=y
CONFIG_CONSOLE=y
CONFIG_UART_CONSOLE=y
CONFIG_UART_INTERRUPT_DRIVEN=y
CONFIG_SERIAL=y
CONFIG_PINMUX=y
CONFIG_SOC_ATMEL_SAMD_XOSC32K=y
CONFIG_SOC_ATMEL_SAMD_XOSC32K_AS_MAIN=y
CONFIG_WIFI=y
CONFIG_WIFI_NINA=y
CONFIG_SPI=y
CONFIG_DEBUG_OPTIMIZATIONS=y
CONFIG_DEBUG=y
CONFIG_GPIO=y
```

## boards/arm/mysensors_gw/Kconfig.board
```kconfig
# Kconfig - Sensebender Gateway board configuration
#
# Copyright (c) 2018 Google LLC.
# SPDX-License-Identifier: Apache-2.0

config BOARD_MYSENSORS_GW
	bool "Sensebender Gateway"
	depends on SOC_PART_NUMBER_SAMD21G18A
```

## boards/arm/mysensors_gw/Kconfig.defconfig
```kconfig
# Kconfig - Sensebender Gateway board configuration
#
# Copyright (c) 2018 Google LLC.
# SPDX-License-Identifier: Apache-2.0

if BOARD_MYSENSORS_GW

config BOARD
	default mysensors_gw

endif # BOARD_MYSENSORS_GW
```

## boards/wch/ch32v003evt/Kconfig.wch_ch32v003evt
```kconfig
# Copyright (c) 2024 Google LLC.
# SPDX-License-Identifier: Apache-2.0

config BOARD_WCH_CH32V003EVT
	select SOC_CH32V003
```

## boards/wch/ch32v003evt/ch32v003evt_defconfig
```kconfig
# Copyright (c) 2024 Michael Hope
# SPDX-License-Identifier: Apache-2.0

CONFIG_MAIN_STACK_SIZE=512

CONFIG_IDLE_STACK_SIZE=256

CONFIG_ISR_STACK_SIZE=256
```

## boards/wch/ch32v003evt/wch_ch32v003evt_defconfig
```kconfig
# Copyright (c) 2024 Google LLC.
# SPDX-License-Identifier: Apache-2.0

CONFIG_CLOCK_CONTROL=y
CONFIG_PINCTRL=y
CONFIG_GPIO=y
```

## boards/weact/ch32v00x_core/Kconfig.ch32v00x_core
```kconfig
# Copyright (c) 2026 Michael Hope
# SPDX-License-Identifier: Apache-2.0

config BOARD_CH32V00X_CORE
	select SOC_CH32V006
```

## drivers/adc/Kconfig.ch32v00x
```kconfig
# Copyright (c) 2024 Google LLC.
# SPDX-License-Identifier: Apache-2.0

config ADC_CH32V00X
	bool "WCH CH32V00x ADC Driver"
	default y
	depends on DT_HAS_WCH_ADC_ENABLED
	help
	  Enable the WCH CH32V00x family Analog-to-Digital Converter (ADC) driver.
```

## drivers/counter/Kconfig.wch_gptm
```kconfig
# Copyright (c) 2025 Michael Hope <michaelh@juju.nz>
# SPDX-License-Identifier: Apache-2.0

config COUNTER_WCH_GPTM
	bool "WCH General-purpose Timer (GPTM) as a counter"
	default y
	depends on DT_HAS_WCH_GPTM_ENABLED
	help
	  Counter driver for the WCH GPTM, such as TIM2 on the CH32V003.


config COUNTER_WCH_GPTM_ALARMS
	bool "Alarm support"
	depends on COUNTER_WCH_GPTM
	default y
	help
	  Support setting alarms. Uses approximately 200 bytes of flash and
	  32 bytes of RAM.
```

## drivers/dma/Kconfig.samd
```kconfig
#
# SPDX-License-Identifier: Apache-2.0
#

menuconfig DMA_SAMD
	bool "Atmel SAMD series DMAC driver"
	default n
	depends on SOC_SERIES_SAMD
	help
	DMA driver for Atmel SAMD series MCUs.
```

## drivers/flash/Kconfig.sam0
```kconfig
# Atmel SAM0 flash driver config

# Copyright (c) 2018 Google LLC.
# SPDX-License-Identifier: Apache-2.0

menuconfig SOC_FLASH_SAM0
	bool "Atmel SAM0 flash driver"
	default y
	depends on SOC_FAMILY_SAM0
	select FLASH_HAS_PAGE_LAYOUT
	select FLASH_HAS_DRIVER_ENABLED
	help
	  Enable the Atmel SAM0 series internal flash driver.

config SOC_FLASH_SAM0_EMULATE_BYTE_PAGES
	bool "Emulate byte-sized pages"
	depends on SOC_FLASH_SAM0
	help
	  Emulate a device with byte-sized pages by doing a
	  read/modify/erase/write.

menuconfig SOC_FLASH_SAM0
	bool "Atmel SAM0 flash driver"
	default y
	depends on SOC_FAMILY_SAM0
	select FLASH_HAS_PAGE_LAYOUT
	select FLASH_HAS_DRIVER_ENABLED
	help
	  Enable the Atmel SAM0 series internal flash driver.

config SOC_FLASH_SAM0_QSPI
	bool "Atmel SAM0 series NOR-on-QSPI driver"
	default y
	depends on SOC_FAMILY_SAM0
	help
	  Enable the Atmel SAM0 series QSPI driver in serial memory mode with an
	  attached JEDEC SPI NOR flash.

config FLASH_SAM0_QSPI_INIT_PRIORITY
	int
	default 80
	help
	  Device driver initialization priority.
	  Device is connected to SPI bus, it has to
	  be initialized after SPI driver.

config FLASH_SAM0_QSPI_FLASH_LAYOUT_PAGE_SIZE
	int "Page size to use for FLASH_LAYOUT feature"
	default 65536
	help
	  When CONFIG_FLASH_PAGE_LAYOUT is used this driver will support
	  that API.  By default the page size corresponds to the block
	  size (65536).  Other options include the 32K-byte erase size
	  (32768), the sector size (4096), or any non-zero multiple of the
	  sector size.
```

## drivers/flash/Kconfig.sam0_qspi
```kconfig
# Copyright (c) 2020 Google LLC.
# SPDX-License-Identifier: Apache-2.0

menuconfig SOC_FLASH_SAM0_QSPI
	bool "Atmel SAM0 QSPI NOR Flash"
	select FLASH_HAS_DRIVER_ENABLED
	help
	  Enable support for the Atmel SAM0 QSPI in Serial memory mode.

if SOC_FLASH_SAM0_QSPI

config SOC_FLASH_SAM0_QSPI_FLASH_LAYOUT_PAGE_SIZE
	int "Page size to use for FLASH_LAYOUT feature"
	default 65536
	help
	  When CONFIG_FLASH_PAGE_LAYOUT is used this driver will support
	  that API.  By default the page size corresponds to the block
	  size (65536).  Other options include the 32K-byte erase size
	  (32768), the sector size (4096), or any non-zero multiple of the
	  sector size.

endif # SOC_FLASH_SAM0_QSPI
```

## drivers/gpio/Kconfig.samd
```kconfig
#
# SPDX-License-Identifier: Apache-2.0
#

menuconfig GPIO_SAMD
	bool "Atmel SAMD GPIO (PORT) driver"
	depends on GPIO && SOC_SERIES_SAMD
	default n
	help
	  Enable config options to support the PORT controllers
	  on Atmel SAMD series processors.

	  Says n if not sure.
```

## drivers/hwinfo/Kconfig.wch
```kconfig
# Copyright (c) 2025 Michael Hope
# SPDX-License-Identifier: Apache-2.0

config HWINFO_WCH
	bool "WCH CH32V Electronic Signature (ESIG)"
	default y
	depends on DT_HAS_WCH_ESIG_ENABLED
	select HWINFO_HAS_DRIVER
	help
	  Enable the WCH CH32V00x Electronic Signature (ESIG) driver.
```

## drivers/i2c/Kconfig.ch32v00x
```kconfig
# SPDX-License-Identifier: Apache-2.0

config I2C_CH32V00X
	bool "CH32V00x I2C driver"
	default y
	depends on DT_HAS_WCH_I2C_ENABLED
	depends on CLOCK_CONTROL
	help
	  Enable the CH32V00x I2C driver.
```

## drivers/pwm/Kconfig.ch32v00x
```kconfig
# Copyright (c) 2024 Google LLC.
# SPDX-License-Identifier: Apache-2.0

config PWM_WCH_GPTM
	bool "WCH General-purpose Timer (GPTM)"
	default y
	depends on DT_HAS_WCH_GPTM_ENABLED
	select PINCTRL
	help
	  PWM driver WCH CH32V00x GPTM such as TIM2 on the CH32V003
```

## drivers/pwm/Kconfig.sam0
```kconfig
# Atmel SAM0 TC as PWM configuration

# Copyright (c) 2020 Google LLC
# SPDX-License-Identifier: Apache-2.0

config PWM_SAM0
	bool "Atmel SAM0 MCU Family PWM Driver"
	depends on SOC_FAMILY_SAM0
	help
	  Enable PWM driver for Atmel SAM0 MCUs.  Uses the TC timer/counter.
```

## drivers/serial/Kconfig.samd
```kconfig
# Kconfig - Atmel SAM SERCOM configuration options
#
# SPDX-License-Identifier: Apache-2.0
#

menuconfig UART_SAMD
	bool "Atmel SAMD series SERCOM USART driver"
	depends on SOC_SERIES_SAMD
	select SERIAL_HAS_DRIVER
	select SERIAL_SUPPORT_INTERRUPT
	default n
	help
	  This option enables the SERCOMx USART driver for Atmel SAMD MCUs.
```

## drivers/spi/Kconfig.wch
```kconfig
# Copyright (c) 2025 MASSDRIVER EI (massdriver.space)
# SPDX-License-Identifier: Apache-2.0

config SPI_WCH
	bool "WCH SPI Controller"
	default y
	depends on DT_HAS_WCH_SPI_ENABLED
	help
	  Enable the SPI peripherals on CH32s

config SPI_WCH_DMA
	bool "WCH SPI COntroller with DMA acceleration"
	depends on SPI_WCH
	select DMA
	help
	  Use direct memory access (DMA) for synchronous transfers.
```
