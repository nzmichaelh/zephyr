## drivers/watchdog/Kconfig.ch32v00x
```kconfig
# Copyright (c) 2024 Google LLC.
# SPDX-License-Identifier: Apache-2.0

config WDT_IWDG_CH32V00X
	bool "CH32V00x Independent Watchdog (IWDG) driver"
	default y
	depends on DT_HAS_WCH_IWDG_ENABLED
	help
	  Enable the Independent Watchdog (IWDG) driver for CH32V00x SOCs.
```

## drivers/watchdog/Kconfig.sam
```kconfig
# Kconfig - Atmel SAM WDT configuration
#
# Copyright (C) 2017 Intel Deutschland GmbH
#
# SPDX-License-Identifier: Apache-2.0
#

menuconfig WDT_SAM
	bool "Atmel SAM3/4/E7 MCU Family Watchdog (WDT) Driver"
	depends on CONFIG_SOC_SERIES_SAM3X || CONFIG_SOC_SERIES_SAM4S || CONFIG_SOC_SERIES_SAME70
	default y
	help
	  Enable WDT driver for Atmel SAM MCUs.

config WDT_SAM_DISABLE_AT_BOOT
	bool "Disable WDT during boot"
	depends on WDT_SAM
	default y
	help
	  Select this option to disable the WDT during boot.

config WDT_SAM_DEVICE_NAME
	string "Device name for Watchdog (WDT)"
	depends on WDT_SAM
	default "WDT"
	help
	  Set the name used by WDT device during registration.
```

## drivers/watchdog/Kconfig.samd
```kconfig
# Kconfig - Atmel SAMD WDT configuration
#
# SPDX-License-Identifier: Apache-2.0
#

menuconfig WDT_SAMD
	bool "Atmel SAMD series Watchdog (WDT) Driver"
	depends on SOC_SERIES_SAMD
	default y
	help
	  Enable WDT driver for Atmel SAMD MCUs.

config WDT_SAMD_DISABLE_AT_BOOT
	bool "Disable WDT during boot"
	depends on WDT_SAMD
	default y
	help
	  Select this option to disable the WDT during boot.
```

## drivers/watchdog/Kconfig.wch
```kconfig
# Copyright (c) 2024 Google LLC.
# SPDX-License-Identifier: Apache-2.0

config WDT_WCH_IWDG
	bool "CH32V00x Independent Watchdog (IWDG) driver"
	default y
	depends on DT_HAS_WCH_IWDG_ENABLED
	help
	  Enable the Independent Watchdog (IWDG) driver for CH32V00x SOCs.
```

## drivers/wifi/nina/Kconfig.nina
```kconfig
# Copyright (c) 2019 Tobias Svehagen
# SPDX-License-Identifier: Apache-2.0

menuconfig WIFI_NINA
	bool "u-blox NINA-W102 support"
	select NET_L2_WIFI_MGMT
	select WIFI_OFFLOAD

if WIFI_NINA

config WIFI_NINA_RX_STACK_SIZE
	int "Stack size for the Espressif esp wifi driver RX thread"
	default 1024
	help
	  This stack is used by the Espressif NINA RX thread.

config WIFI_NINA_RX_THREAD_PRIORITY
	int "Priority of RX thread"
	default 7
	help
	  Priority of thread used for processing RX data.

config WIFI_NINA_WORKQ_STACK_SIZE
	int "Stack size for the esp driver work queue"
	default 2048
	help
	  This stack is used by the work queue to pass off net_pkt data
	  to the rest of the network stack, letting the rx thread continue
	  processing data.

config WIFI_NINA_WORKQ_THREAD_PRIORITY
	int "Priority of work queue thread"
	default 7
	help
	  Priority of thread used for processing driver work queue items.

config WIFI_NINA_RESET_TIMEOUT
	int "Reset timeout"
	default 3000
	help
	  How long to wait for device to become ready after AT+RST has been
	  sent. This can vary with chipset (NINA8266/NINA32) and firmware
	  version. This is ignored if a reset pin is configured.

endif # WIFI_NINA
```

## dts/bindings/adc/wch,adc.yaml
```yaml
# Copyright (c) 2024 Google LLC.
# SPDX-License-Identifier: Apache-2.0

description: WCH CH32V00x Analog-to-digital Converter (ADC)

compatible: "wch,adc"

include: adc-controller.yaml

properties:
  reg:
    required: true

  interrupts:
    required: true

  clocks:
    required: true

  vref-mv:
    type: int
    default: 3300
    description: |
      Reference voltage of in mV. This is typically VDD.

  "#io-channel-cells":
    const: 1

io-channel-cells:
  - input
```

## dts/bindings/arm/atmel,sam0-soft-spi.yaml
```yaml
description: Atmel SAM0 multi-protocol (UART, SPI, I2C) SERCOM unit

compatible: "atmel,sam0-soft-spi"

include: spi-controller.yaml

properties:
  sclk:
    required: true
    type: phandle
```

## dts/bindings/clock/wch,ch32v20x_30x-hse-clock.yaml
```yaml
# Copyright (c) 2024 Google LLC.
# SPDX-License-Identifier: Apache-2.0

description: WCH CH32V20x/30x High Speed External (HSE) clock

compatible: "wch,ch32v20x_30x-hse-clock"

include: [fixed-clock.yaml]
```

## dts/bindings/clock/wch,ch32v20x_30x-hsi-clock.yaml
```yaml
# Copyright (c) 2024 Google LLC.
# SPDX-License-Identifier: Apache-2.0

description: WCH CH32V20x/30x High Speed Internal (HSI) clock

compatible: "wch,ch32v20x_30x-hsi-clock"

include: [fixed-clock.yaml]
```

## dts/bindings/debug/wch,qingkev2-debug.yaml
```yaml
# Copyright (c) 2024 Google LLC.
# SPDX-License-Identifier: Apache-2.0

description: WCH QingKeV2 Debug

compatible: "wch,qingkev2-debug"

include: base.yaml
```

## dts/bindings/dma/atmel,sam0-dma.yaml
```yaml
#
# Copyright (c) 2018, Google LLC.
#
# SPDX-License-Identifier: Apache-2.0
#
---
title: Atmel SAM0 Direct Memory Access Controller (DMAC)
id: atmel,sam0-dma
version: 0.1

description: Atmel SAM0 Direct Memory Access Controller (DMAC)

properties:
    compatible:
      type: string
      category: required
      description: compatible strings
      constraint: "atmel,sam0-dma"

    reg:
      type: array
      description: mmio register space
      generation: define
      category: required

    interrupts:
      type: array
      category: required
      description: required interrupts
      generation: define

    label:
      type: string
      description: Human readable string describing the device
      generation: define

cell_string: DMA

"#cells":
  - name
  - channel
...
```

## dts/bindings/gpio/atmel,samd-gpio.yaml
```yaml
---
title: SAMD GPIO
version: 0.1

description: >
    This is a representation of the SAMD GPIO PORT nodes

properties:
  - compatible:
      type: string
      category: required
      description: compatible strings
      constraint: "atmel,samd-gpio"

  - reg:
      type: int
      description: mmio register space
      generation: define
      category: required

  - label:
      type: string
      category: required
      description: Human readable string describing the device (used by Zephyr for API name)
      generation: define
```

## dts/bindings/hwinfo/wch,esig.yaml
```yaml
# Copyright (c) 2025 Michael Hope
# SPDX-License-Identifier: Apache-2.0

description: WCH CH32V Electronic Signature (ESIG)

compatible: "wch,esig"

include: base.yaml

properties:
  reg:
    required: true
```

## dts/bindings/i2c/wch,i2c.yaml
```yaml
# SPDX-License-Identifier: Apache-2.0

description: WCH CH32V00x I2C

compatible: "wch,i2c"

include: [i2c-controller.yaml, pinctrl-device.yaml]

properties:
  reg:
    required: true

  interrupts:
    required: true

  clocks:
    required: true

  pinctrl-0:
    required: true

  pinctrl-names:
    required: true
```

## dts/bindings/mmc/mmc-spi-slot.yaml
```yaml
#
# Copyright (c) 2018, I-SENSE group of ICCS
#
# SPDX-License-Identifier: Apache-2.0
#
---
title: MMC/SD/SDIO slot directly connected to a SPI bus
id: zephyr,mmc-spi-slot
version: 0.1

description: MMC/SD/SDIO slot directly connected to a SPI bus

inherits:
    !include spi-device.yaml

properties:
    compatible:
      constraint: "zephyr,mmc-spi-slot"

    gpios:
      type: array
      category: optional
      description: pinmux information for CS
      generation: structures
...
```

## dts/bindings/mtd/jedec,psram.yaml
```yaml
# Copyright (c) 2018 Peter Bigot Consulting, LLC
# Copyright (c) 2019 Nordic Semiconductor ASA
# SPDX-License-Identifier: Apache-2.0

description: |
  Properties supporting Zephyr spi-nor flash driver (over the Zephyr SPI
  API) control of serial flash memories using the standard M25P80-based
  command set.

compatible: "jedec,psram"

include: [spi-device.yaml, "jedec,spi-nor-common.yaml"]
```

## dts/bindings/pwm/wch,gptm.yaml
```yaml
# Copyright (c) 2024 Google LLC.
# SPDX-License-Identifier: Apache-2.0

description: WCH General-purpose Timer (GPTM)

compatible: "wch,gptm"

include: [base.yaml, pwm-controller.yaml, pinctrl-device.yaml]

properties:
  prescaler:
    type: int
    default: 1
    description: Counter prescaler (1 to 65536)

  "#pwm-cells":
    const: 3

pwm-cells:
  - channel
  - period
  - flags
```

## dts/bindings/serial/atmel,samd-usart.yaml
```yaml
---
title: Atmel SAMD SERCOM USART driver
id: atmel,samd-usart
version: 0.1

description: >
    This binding gives a base representation of the Atmel SAMD SERCOM USART driver

inherits:
  - !include uart.yaml

properties:
  - compatible:
      type: string
      category: required
      description: compatible strings
      constraint: "atmel,samd-usart"

  - reg:
      type: array
      description: mmio register space
      generation: define
      category: required

...
```

## dts/bindings/spi/atmel,sam0-qspi.yaml
```yaml
description: |
  Atmel SAM0 QSPI peripheral

compatible: "atmel,sam0-qspi"

include: spi-controller.yaml

properties:
    reg:
      required: true

    interrupts:
      required: true

    clocks:
      required: true
```

## dts/bindings/spi/wch,spi.yaml
```yaml
# Copyright (c) 2025 MASSDRIVER EI (massdriver.space)
# SPDX-License-Identifier: Apache-2.0

description: WCH SPI

compatible: "wch,spi"

include: [spi-controller.yaml, pinctrl-device.yaml]

properties:
  reg:
    required: true

  clocks:
    required: true

  pinctrl-0:
    required: true

  pinctrl-names:
    required: true

  dmas:
    description: |
      TX and RX DMA specifiers. Each specifier is a reference to the DMA
      controller and the channel number. The channel number is fixed
      by the hardware. Note that Zephyr used zero based channels, while
      the datasheet uses one based.

  dma-names:
    description: |
      Must be "tx" and "rx" and match the order given for `dmas`.
```

## dts/bindings/timer/wch,systick.yaml
```yaml
# Copyright (c) 2024 Google LLC.
# SPDX-License-Identifier: Apache-2.0

description: Systick

compatible: "wch,systick"

include: base.yaml

properties:
  reg:
    required: true

  interrupts:
    required: true
```

## dts/bindings/watchdog/atmel,samd-watchdog.yaml
```yaml
---
title: SAMD watchdog
id: atmel,samd-watchdog
version: 0.1

description: >
    This is a representation of the SAMD watchdog

properties:
  - compatible:
      type: string
      category: required
      description: compatible strings
      constraint: "atmel,samd-watchdog"

  - reg:
      type: int
      description: mmio register space
      generation: define
      category: required

  - label:
      type: string
      category: required
      description: Human readable string describing the device (used by Zephyr for API name)
      generation: define
```

## dts/bindings/watchdog/wch,iwdg.yaml
```yaml
# Copyright (c) 2024 Google LLC.
# SPDX-License-Identifier: Apache-2.0

description: CH32V00x Independent Watchdog (IWDG)

compatible: "wch,iwdg"

include: base.yaml

properties:
  reg:
    required: true
```

## dts/bindings/wifi/u-blox,nina.yaml
```yaml
# Copyright (c) 2018, Linaro Limited
# SPDX-License-Identifier: Apache-2.0

description: u-blox NINA Wifi module

compatible: "u-blox,nina"

include: spi-device.yaml

properties:
    irq-gpios:
      type: phandle-array
      required: true

    reset-gpios:
      type: phandle-array
      required: true

    ready-gpios:
      type: phandle-array
      required: true
```
