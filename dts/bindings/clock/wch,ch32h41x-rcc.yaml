## dts/bindings/clock/wch,ch32h41x-rcc.yaml
```yaml
# Copyright (c) 2026 Michael Hope
# SPDX-License-Identifier: Apache-2.0

description: |
  WCH CH32H41x Reset and Clock Control (RCC).

  This binding extends the common WCH RCC controller with the bus and ADC
  clock prescalers available on the CH32H41x series. See
  wch,rcc.yaml for the common clock controller properties.

compatible: "wch,ch32h41x-rcc"

include:
  - name: wch,rcc.yaml

properties:
  hb-prescaler:
    type: int
    default: 1
    description: |
      HB bus clock (HCLK) prescaler. The CORE1 (v5f) clock is the system clock
      (SYSCLK) divided by this. The default matches the RCC reset value, which
      leaves SYSCLK undivided.
    enum:
      - 1
      - 2
      - 4
      - 8
      - 16
      - 64
      - 128
      - 256
      - 512

  f-prescaler:
    type: int
    default: 4
    description: |
      HB bus clock (HCLK) prescaler. HCLK is the system clock (SYSCLK) divided
      by this and HPRE and also feeds CORE0 (v3f).
    enum:
      - 1
      - 2
      - 4

  pb2-prescaler:
    type: int
    default: 1
    description: |
      PB2 bus clock (PCLK2) prescaler. PCLK2 is HCLK divided by this value.
      The default matches the RCC reset value, which leaves PCLK2 undivided.
    enum:
      - 1
      - 2
      - 4
      - 8
      - 16

  adc-prescaler:
    type: int
    default: 2
    description: |
      ADC clock prescaler. The ADC clock is PCLK2 divided by this value.
      The default matches the RCC reset value, which divides PCLK2 by 2.
    enum:
      - 2
      - 4
      - 6
      - 8
```

## dts/bindings/clock/wch,ch32v00x-rcc.yaml
```yaml
# Copyright (c) 2026 Michael Hope
# SPDX-License-Identifier: Apache-2.0

description: |
  WCH CH32V00x Reset and Clock Control (RCC).

  This binding extends the common WCH RCC controller with the clock tree
  configuration specific to the CH32003 and the CH32V00x family. See
  wch,rcc.yaml for the common clock controller properties.

compatible: "wch,ch32v00x-rcc"

include:
  - name: wch,rcc.yaml

properties:
  hb-prescaler:
    type: int
    default: 1
    description: |
      HB bus clock (HCLK) prescaler. HCLK is the system clock (SYSCLK)
      divided by this value. The default matches the HCLK configuration
      applied by the clock controller driver.
    enum:
      - 1
      - 2
      - 3
      - 4
      - 5
      - 6
      - 7
      - 8
      - 16
      - 32
      - 64
      - 128
      - 256

  adc-prescaler:
    type: int
    default: 2
    description: |
      ADC clock prescaler. The ADC clock is HCLK divided by this value.
      The default matches the RCC reset value, which divides HCLK by 2.
    enum:
      - 2
      - 4
      - 6
      - 8
      - 12
      - 16
      - 24
      - 32
      - 48
      - 64
      - 96
      - 128
```

## dts/bindings/clock/wch,ch32v208-rcc.yaml
```yaml
# Copyright (c) 2026 Michael Hope
# SPDX-License-Identifier: Apache-2.0

description: |
  CH32V208/203RB RCC (Reset and Clock controller).

  See `wch,rcc.yaml` for more

compatible: "wch,ch32v208-rcc"

include:
  - name: wch,rcc.yaml

hsi-prescaler:
  type: int
  default: 1
  description: HSI prescaler before feeding the PLL
  enum:
    - 1
    - 2

hse-prescaler:
  type: int
  default: 4
  description: HSE prescaler before feeding the PLL
  enum:
    - 2
    - 4
    - 8

hb-prescaler:
  type: int
  default: 1
  enum:
    - 1
    - 2
    - 4
    - 8
    - 16
    - 64
    - 256
    - 512

pb1-prescaler:
  type: int
  default: 1
  enum:
    - 1
    - 2
    - 4
    - 8
    - 16

pb2-prescaler:
  type: int
  default: 1
  enum:
    - 1
    - 2
    - 4
    - 8
    - 16

adc-prescaler:
  type: int
  default: 2
  enum:
    - 2
    - 4
    - 6
    - 8
```

## dts/bindings/clock/wch,ch32v20x_30x-rcc.yaml
```yaml
# Copyright (c) 2026 Michael Hope
# SPDX-License-Identifier: Apache-2.0

description: |
  WCH CH32V20x/CH32V30x Reset and Clock Control (RCC).

  This binding extends the common WCH RCC controller with the bus and ADC
  clock prescalers available on the CH32V20x and CH32V30x families. See
  wch,rcc.yaml for the common clock controller properties.

compatible: "wch,ch32v20x_30x-rcc"

include:
  - name: wch,rcc.yaml

properties:
  hb-prescaler:
    type: int
    default: 1
    description: |
      HB bus clock (HCLK) prescaler. HCLK is the system clock (SYSCLK)
      divided by this value. The default matches the RCC reset value, which
      leaves HCLK undivided.
    enum:
      - 1
      - 2
      - 4
      - 8
      - 16
      - 64
      - 128
      - 256
      - 512

  pb1-prescaler:
    type: int
    default: 1
    description: |
      PB1 bus clock (PCLK1) prescaler. PCLK1 is HCLK divided by this value.
      The default matches the RCC reset value, which leaves PCLK1 undivided.
    enum:
      - 1
      - 2
      - 4
      - 8
      - 16

  pb2-prescaler:
    type: int
    default: 1
    description: |
      PB2 bus clock (PCLK2) prescaler. PCLK2 is HCLK divided by this value.
      The default matches the RCC reset value, which leaves PCLK2 undivided.
    enum:
      - 1
      - 2
      - 4
      - 8
      - 16

  adc-prescaler:
    type: int
    default: 2
    description: |
      ADC clock prescaler. The ADC clock is PCLK2 divided by this value.
      The default matches the RCC reset value, which divides PCLK2 by 2.
    enum:
      - 2
      - 4
      - 6
      - 8
```

## dts/bindings/clock/wch,ch32v305-rcc.yaml
```yaml
# Copyright (c) 2026 Michael Hope
# SPDX-License-Identifier: Apache-2.0

description: |
  CH32V305/307/317 RCC (Reset and Clock controller).

  See `wch,rcc.yaml` for more

compatible: "wch,ch32v208-rcc"

include:
  - name: wch,rcc.yaml

hsi-prescaler:
  type: int
  default: 1
  description: HSI prescaler before feeding PLL1
  enum:
    - 1
    - 2

prediv1:
  type: int
  default: 1
  description: HSE prescaler before feeding PLL1
  enum:
    - 1
    - 2
    - 3
    - 4
    - 5
    - 6
    - 7
    - 8
    - 9
    - 10
    - 11
    - 12
    - 13
    - 14
    - 15
    - 16

hb-prescaler:
  type: int
  default: 1
  enum:
    - 1
    - 2
    - 4
    - 8
    - 16
    - 64
    - 256
    - 512

pb1-prescaler:
  type: int
  default: 1
  enum:
    - 1
    - 2
    - 4
    - 8
    - 16

pb2-prescaler:
  type: int
  default: 1
  enum:
    - 1
    - 2
    - 4
    - 8
    - 16

adc-prescaler:
  type: int
  default: 2
  enum:
    - 2
    - 4
    - 6
    - 8
```

## dts/bindings/clock/wch,rcc.yaml
```yaml
# Copyright (c) 2024 Michael Hope
# SPDX-License-Identifier: Apache-2.0

description: |
  WCH CH32 Reset and Clock Control (RCC)

  This node implements the system clock source selection and controls clocks
  for the High Performance Bus (HB) and peripheral busses.

  `wch,rcc` contains all common properties. Each series inherits from this.

compatible: "wch,rcc"

include: [clock-controller.yaml, base.yaml]

properties:
  "#clock-cells":
    const: 1

clock-cells:
  - id
```
