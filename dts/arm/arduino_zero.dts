/*
 * Copyright (c) 2017 Linaro Limited
 *
 * SPDX-License-Identifier: Apache-2.0
 */

/dts-v1/;
#include <atmel/samd21.dtsi>

/ {
	model = "Arduino Zero";
	compatible = "arduino,zero", "atmel,samd21g18a", "atmel,samd21";

	chosen {
		zephyr,console = &sercom5;
		zephyr,sram = &sram0;
		zephyr,flash = &flash0;
	};
};

&sercom5 {
	status = "ok";
	current-speed = <460800>;
};
&sercom0 {
	status = "ok";
	current-speed = <115200>;
};
